## sdkconfig.defaults
```kconfig
CONFIG_ESPTOOLPY_FLASHSIZE_4MB=y
CONFIG_ESPTOOLPY_FLASHMODE_DIO=y
CONFIG_ESPTOOLPY_FLASHFREQ_40M=y

# Skip MPU configuration in bootloader, required for
# allowing its configuration in NuttX image
CONFIG_BOOTLOADER_REGION_PROTECTION_ENABLE=n

# Use the partition table from this repository
CONFIG_PARTITION_TABLE_CUSTOM=y
CONFIG_PARTITION_TABLE_CUSTOM_FILENAME="partitions.csv"
CONFIG_PARTITION_TABLE_OFFSET=0x8000
```

## sdkconfig.defaults.esp32c2
```kconfig
# Skip MPU configuration in bootloader, required for
# allowing its configuration in NuttX image
CONFIG_BOOTLOADER_REGION_PROTECTION_ENABLE=n

# Use the partition table from this repository
CONFIG_PARTITION_TABLE_CUSTOM=y
CONFIG_PARTITION_TABLE_CUSTOM_FILENAME="partitions.csv"
```
